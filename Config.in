## Config.in
```kconfig
mainmenu "Project Configuration"

source "common/Config.in"
source "configs/Config.in"
source "externel/Config.in"
```

## common/Config.in
```kconfig
menu "Log Support"

config PTHREAD_LOG
    bool "user pthread log"
    default n
    help
      Allow config pthread safe log.

endmenu
```
